/*********************************************************************************************
* 文件：main.c
* 作者：chennian 2017.11.02
* 说明：D1、D2、D3、D4驱动实验代码     
* 功能：
* 修改：

*********************************************************************************************/

/*********************************************************************************************
* 头文件
*********************************************************************************************/
#include "stm32f4xx.h"
#include "delay.h"
#include "led.h"
#include "key.h"
/*********************************************************************************************
* 名称：main()
* 功能：LED实验逻辑代码
* 参数：无
* 返回：无
* 修改：
*********************************************************************************************/
void main(void)
{
  char led_status = 0;                                          //声明一个表示LED状态的变量
  led_init();                                                   //初始化LED控制管脚
  key_init();                                                   //初始化按键检测管脚
  while(1){                                                     //循环体
    if(get_key_status() == K3_PREESED){                         //检测K3被按下
      delay_count(500);                                         //延时消抖
      if(get_key_status() == K3_PREESED){                       //确认K3被按下
        while(get_key_status() == K3_PREESED);                  //等待按键松开
        led_status++;                                           //LED状态变量加一
        if (led_status>4)                                       //LED状态变量最大为4
          led_status=0;                                         //LED状态变量置零
      }
    }
    
    switch(led_status){    
    case 0: 
      turn_off(D1);                                             //关闭D1
      turn_off(D2);                                             //关闭D2
      turn_off(D3);                                             //关闭D3
      turn_off(D4);                                             //关闭D4
      break;
      
    case 1:turn_on(D1);break;                                   //点亮D1
    case 2:turn_on(D2);break;                                   //点亮D2
    case 3:turn_on(D3);break;                                   //点亮D3
    case 4:turn_on(D4);break;                                   //点亮D4
    
    default:led_status=0;                                       //led_status清零
    }
  }
}  
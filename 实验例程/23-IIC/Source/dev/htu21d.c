/*********************************************************************************************
* 文件: htu21d.c
* 作者：zonesion 2016.12.22
* 说明：板载温湿度相关函数  
* 修改：
* 注释：
*********************************************************************************************/
#include <stdio.h>
#include "stm32f4xx.h"
#include "iic.h"
#include "delay.h"

/*********************************************************************************************
* 名称:HTU21DGPIOInit()
* 功能:初始化HTU21D
* 参数:无
* 返回:无
* 修改:
* 注释:
*********************************************************************************************/
void HTU21DGPIOInit(void)
{
  iic_init(); 
}

/*********************************************************************************************
* 名称:i2c_write()
* 功能:I2C写
* 参数:char addr -- 地址, char *buf -- 发送数据, int len -- 发送数据长度
* 返回:0/-1
* 修改:
* 注释:
*********************************************************************************************/

static int i2c_write(char addr, char *buf, int len)
{
  iic_start();
  if (iic_write_byte(addr<<1)){ 
    iic_stop(); 
    return -1;
  }
  for (int i=0; i<len; i++) {
    if (iic_write_byte(buf[i])) {
      iic_stop(); 
      return -1;
    }
  }
  iic_stop();
  return 0;
}

/*********************************************************************************************
* 名称:i2c_read()
* 功能:I2C读
* 参数:char addr -- 地址, char *buf -- 发送数据, int len -- 发送数据长度
* 返回:数据长度/-1
* 修改:
* 注释:
*********************************************************************************************/
static int i2c_read(char addr, char *buf, int len)
{
  int i;
  
  iic_start();
  if (iic_write_byte((addr<<1)|1)) {
    iic_stop();
    return -1;
  }
  
  for (i=0; i<len-1; i++) {
    buf[i] = iic_read_byte(0);
  }
  buf[i] = iic_read_byte(0);
  iic_stop();
  return len;
}
#define HTU21D_ADDR 0x40

/*********************************************************************************************
* 名称:htu21d_reset()
* 功能:htu21d重启
* 参数:无
* 返回:
* 修改:
* 注释:
*********************************************************************************************/
void htu21d_reset(void)
{
  char cmd = 0xfe;
  i2c_write(HTU21D_ADDR, &cmd, 1); 								//reset
}
/*********************************************************************************************
* 名称:htu21d_mesure_t()
* 功能:发送读取温度指令
* 参数:无
* 返回:无
* 修改:
* 注释:
*********************************************************************************************/
void htu21d_mesure_t(void)
{
  char cmd = 0xf3;
  i2c_write(HTU21D_ADDR, &cmd, 1);
}

/*********************************************************************************************
* 名称:htu21d_mesure_h()
* 功能:发送读取湿度命令
* 参数:无
* 返回:无
* 修改:
* 注释:
*********************************************************************************************/
void htu21d_mesure_h(void)
{
  char cmd = 0xf5;
  i2c_write(HTU21D_ADDR, &cmd, 1);
}

/*********************************************************************************************
* 名称:htu21d_init()
* 功能:htu21d初始化
* 参数:无
* 返回:无
* 修改:
* 注释:
*********************************************************************************************/
void htu21d_init(void)
{
  char cmd = 0xfe;
  HTU21DGPIOInit();
  i2c_write(HTU21D_ADDR, &cmd, 1); 								//reset
  delay_ms(20);
}

/*********************************************************************************************
* 名称:htu21d_read_temp()
* 功能:读取温度原始数据
* 参数:无
* 返回:char dat -- 未处理的温度值
* 修改:
* 注释:
*********************************************************************************************/
char htu21d_read_temp(void)
{
  char cmd = 0xf3;
  char dat;
  
  i2c_write(HTU21D_ADDR, &cmd, 1);
  delay_ms(50);
  i2c_read(HTU21D_ADDR, &dat, 1);
  return dat;
}

/*********************************************************************************************
* 名称:htu21d_read_hemp()
* 功能:读取湿度原始数据
* 参数:无
* 返回:char dat -- 未处理的湿度值
* 修改:
* 注释:
*********************************************************************************************/
char htu21d_read_humi(void)
{
  char cmd = 0xf5;
  char dat;
  
  i2c_write(HTU21D_ADDR, &cmd, 1);
  delay_ms(50);
  i2c_read(HTU21D_ADDR, &dat, 1);
  return dat;
}


/*********************************************************************************************
* 名称:htu21d_t()
* 功能:读取温度
* 参数:无
* 返回:-1/float t -- 处理后的温度值
* 修改:
* 注释:
*********************************************************************************************/
float htu21d_t(void)
{
  char cmd = 0xf3;
  char dat[4];
  i2c_write(HTU21D_ADDR, &cmd, 1);
  delay_ms(50);
  if (i2c_read(HTU21D_ADDR, dat, 2) == 2) {
    if ((dat[1]&0x02) == 0) {
      float t = -46.85f + 175.72f * ((dat[0]<<8 | dat[1])&0xfffc) / (1<<16);
      return t;
    }
  }
  return -1;
}

/*********************************************************************************************
* 名称:htu21d_h()
* 功能:读取湿度
* 参数:无
* 返回:-1/float h -- 处理后的湿度值
* 修改:
* 注释:
*********************************************************************************************/
float htu21d_h(void)
{
  char cmd = 0xf5;
  char dat[4];
  
  i2c_write(HTU21D_ADDR, &cmd, 1);
  delay_ms(50);
  if (i2c_read(HTU21D_ADDR, dat, 2) == 2) {
    if ((dat[1]&0x02) == 0x02) {
      float h = -6 + 125 * ((dat[0]<<8 | dat[1])&0xfffc) / (1<<16);
      return h;
    }
  }
  return -1;
}



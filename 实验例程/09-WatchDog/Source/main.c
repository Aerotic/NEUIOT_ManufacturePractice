/*********************************************************************************************
* 文件：main.c
* 作者：Meixin 2017.09.26
* 说明：看门狗实验 例程    
*       通过代码的变更实现看门狗的喂狗操作
* 修改：
* 注释：
*********************************************************************************************/

/*********************************************************************************************
* 头文件
*********************************************************************************************/
#include <ioCC2530.h>
#include "delay.h"
#include "clock.h"
#include "led.h"
#include "key.h"
#include "watch_dog.h"

/*********************************************************************************************
* 名称：main()
* 功能：逻辑代码
* 参数：无
* 返回：无
* 修改：
* 注释：
*********************************************************************************************/
void main(void)
{
  xtal_init();                                                  //CC2530时钟初始化
  led_init();                                                   //LED灯管脚初始化
  key_init();                                                   //按键的控制端口初始化
  watchdog_init();                                              //看门狗初始化 

  D1 = OFF;                                                     //D1熄灭
  D2 = OFF;                                                     //D2熄灭
  delay_ms(500);                                                //延时500ms
  
  while(1)
  {
    D1 = ON;                                                    //D1点亮
    D2 = ON;                                                    //D2点亮
    
    if(K1 == DOWN)                                              //按键按下
    {
      delay_ms(10);                                             //按键防抖
      if(K1 == DOWN)                                            //再次检测按键按下
      {
        feet_dog();                                             //喂狗操作  
      }
    }
  }
}
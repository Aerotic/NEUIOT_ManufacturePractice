/*********************************************************************************************
* 文件：stadiometry.c
* 作者：Lixm 2017.10.17
* 说明：红外测距驱动代码
* 修改：
* 注释：
*********************************************************************************************/

/*********************************************************************************************
* 头文件
*********************************************************************************************/
#include "stadiometry.h"
#include "adc.h"
/*********************************************************************************************
* 名称：stadiometry_init()
* 功能：红外测距传感器初始化
* 参数：无
* 返回：无
* 修改：
* 注释：
*********************************************************************************************/
void stadiometry_init(void)
{
  PinTypeADC(PIN_59,PIN_MODE_255);
  ADCChannelEnable(ADC_BASE, ADC_CH_2);//使能ADC通道3
  ADCTimerConfig(ADC_BASE, 2^17);       //配置ADC内部定时器
  ADCTimerEnable(ADC_BASE);             //使能内部定时器   
  ADCEnable(ADC_BASE);                  //ADC使能
}

/*********************************************************************************************
* 名称：float get_stadiometry_data(void)
* 功能：获取红外测距传感器状态
* 参数：无
* 返回：无
* 修改：
* 注释：
*********************************************************************************************/
float get_stadiometry_data(void)
{ 
  float dis = 0;
  unsigned int  value = 0;
  while(!ADCFIFOLvlGet(ADC_BASE, ADC_CH_2));
  value = ADCFIFORead(ADC_BASE, ADC_CH_2);
  float v = ((value >> 2 ) & 0x0FFF)*1.467/4096;  //计算电压
  

  if (v>0.45 && v <= 0.75) { //600--400
     dis = 600 - (v-0.45) * 200 / 0.3f;
  } else if (v>0.75 && v<=1.0) {//400--300
     dis = 400 - (v-0.75) * 100/0.25f;
  } else if (v>1.0 && v<1.46) {//300 -- 200
     dis = 300 - (v-1.0)*100/0.47f;
  } 
  
  //Report("v = %.2f, d %.0fmm\r\n", v, dis);
  return dis/10.0f;
}